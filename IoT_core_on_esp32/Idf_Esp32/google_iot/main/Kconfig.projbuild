## IoT_core_on_esp32/Idf_Esp32/google_iot/main/Kconfig.projbuild
```kconfig
menu "Example Configuration"

config ESP_WIFI_SSID
    string "WiFi SSID"
    default "akshay"
    help
	SSID (network name) for the example to connect to.

config ESP_WIFI_PASSWORD
    string "WiFi Password"
    default "sharma98"
    help
	WiFi password (WPA or WPA2) for the example to use.

config OUTPUT_GPIO
    int "Output GPIO"
    default 27
    help
    This is the GPIO on which output will be set.

endmenu
```
